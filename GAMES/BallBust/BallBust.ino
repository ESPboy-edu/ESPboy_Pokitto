#include "Pokitto.h"
#include <stdint.h>

Pokitto::Core pok;
using PD = Pokitto::Display;

#define min(a,b) ((a) < (b) ? (a) : (b))
#define max(a,b) ((a) < (b) ? (b) : (a))

PROGMEM static const uint8_t start[4842] = {
110,88,
//frame 0
0x77,0x77,0x77,0x77,0x77,0x77,0x77,0x77,0x77,0x77,0x77,0x77,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0x77,
0x77,0x77,0x77,0x77,0x77,0x77,0x77,0x77,0x77,0x77,0x77,0x77,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0x77,
0x77,0x77,0x77,0x77,0x77,0x77,0x77,0x77,0x77,0x77,0x77,0x77,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0x77,
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0x99,0x99,0x99,0x99,0x99,0x99,0x99,0x99,0x99,0x99,0x99,0x99,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0x99,
};

PROGMEM static const uint8_t pokinemy0[] = {
8,16,
//frame 0
0x44,0x40,0x00,0x04,
0x44,0x00,0x00,0x10,
0x44,0x00,0x00,0x00,
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0x54,0x44,0x44,0x46,
};
PROGMEM static const uint8_t pokinemy1[] = {
8,16,
//frame 4
0x44,0x00,0x00,0x44,
0x40,0x00,0x01,0x04,
0x40,0x00,0x00,0x04,
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0x44,0x55,0x46,0x44,
};
PROGMEM static const uint8_t pokinemy2[] = {
8,16,
//frame 4
0x40,0x00,0x04,0x44,
0x00,0x00,0x10,0x44,
0x00,0x00,0x00,0x44,
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0x44,0x64,0x45,0x54,
};
PROGMEM static const uint8_t pokinemy3[] = {
8,16,
//frame 4
0x44,0x00,0x00,0x44,
0x40,0x00,0x01,0x04,
0x40,0x00,0x00,0x04,
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0x44,0x55,0x46,0x44,
};

PROGMEM static const uint8_t pokinemycrawl[] = {
4,16,
//frame 0
0x44,0x00,
0x40,0x10,
0x40,0x00,
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0x44,0x54,
};

PROGMEM static const uint8_t pokiheart[34] = {
8,8,
//frame 0
0x44,0x44,0x44,0x44,
0x40,0x04,0x00,0x44,
0x05,0x50,0x55,0x04,
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0x44,0x40,0x44,0x44,
};

PROGMEM static const uint8_t pokiball[32] = {
6,10,
//frame 0
0x44,0x40,0x04,
0x40,0x03,0x34,
0x40,0x33,0x34,
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0x44,0x44,0x44,
};

PROGMEM static const uint8_t pokiboi0[] = {
16,24,
//frame 0
0x44,0x44,0x44,0x44,0x44,0x44,0x44,0x44,
0x44,0x44,0x44,0x44,0x44,0x44,0x44,0x44,
0x44,0x44,0x00,0x00,0x00,0x00,0x44,0x44,
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0x44,0x44,0x44,0x44,0x44,0x44,0x44,0x44,
};
PROGMEM static const uint8_t pokiboi1[] = {
16,24,
//frame 8
0x44,0x44,0x44,0x44,0x44,0x44,0x44,0x44,
0x44,0x44,0x00,0x00,0x00,0x00,0x44,0x44,
0x44,0x40,0x00,0x00,0x00,0x00,0x04,0x44,
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0x44,0x44,0x44,0x44,0x44,0x44,0x44,0x44,
};
PROGMEM static const uint8_t pokiboi2[] = {
16,24,
//frame 8
0x44,0x44,0x00,0x00,0x00,0x00,0x44,0x44,
0x44,0x40,0x00,0x00,0x00,0x00,0x04,0x44,
0x44,0x40,0x00,0x10,0x00,0x10,0x04,0x44,
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0x44,0x44,0x44,0x44,0x44,0x44,0x44,0x44,
};
PROGMEM static const uint8_t pokiboi3[] = {
16,24,
//frame 8
0x44,0x44,0x44,0x44,0x44,0x44,0x44,0x44,
0x44,0x44,0x44,0x44,0x44,0x44,0x44,0x44,
0x44,0x44,0x44,0x44,0x44,0x44,0x44,0x44,
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0x44,0x44,0x44,0x44,0x44,0x44,0x44,0x44,
};
PROGMEM static const uint8_t pokiboi5[] = {
16,24,
//frame 8
0x44,0x44,0x44,0x44,0x44,0x44,0x44,0x44,
0x44,0x44,0x00,0x00,0x00,0x00,0x44,0x44,
0x44,0x40,0x00,0x00,0x00,0x00,0x04,0x44,
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0x44,0x44,0x44,0x44,0x44,0x44,0x44,0x44,
};
PROGMEM static const uint8_t pokiboi6[] = {
16,24,
//frame 8
0x44,0x44,0x00,0x00,0x00,0x00,0x44,0x44,
0x44,0x40,0x00,0x00,0x00,0x00,0x04,0x44,
0x44,0x40,0x00,0x10,0x00,0x10,0x04,0x44,
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0x44,0x44,0x44,0x44,0x44,0x44,0x44,0x44,
};
PROGMEM static const uint8_t pokiboi7[] = {
16,24,
//frame 8
0x44,0x44,0x44,0x44,0x44,0x44,0x44,0x44,
0x44,0x44,0x44,0x44,0x44,0x44,0x44,0x44,
0x44,0x44,0x44,0x44,0x44,0x44,0x44,0x44,
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0x44,0x44,0x44,0x44,0x44,0x44,0x44,0x44,
};

PROGMEM static const uint8_t pokiballfast[32] = {
6,10,
//frame 0
0x44,0x40,0x04,
0x40,0x05,0x54,
0x40,0x55,0x54,
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0x44,0x44,0x44,
};
PROGMEM static const uint8_t pokiballlast1[16] = {
4,7,
//frame 0
0x44,0x00,
0x40,0x66,
0x06,0x66,
0x06,0x66,
0x06,0x66,
0x40,0x66,
0x44,0x00,
};
PROGMEM static const uint8_t pokiballlast2[14] = {
4,6,
//frame 0
0x44,0x04,
0x40,0x64,
0x06,0x64,
0x40,0x64,
0x44,0x04,
0x44,0x44,
};
PROGMEM static const uint8_t pokiballlast3[6] = {
2,4,
//frame 0
0x40,
0x06,
0x40,
0x44,
};


PROGMEM static const uint8_t scores[82] = {
20,8,
//frame 0
0x11,0x14,0x11,0x14,0x11,0x14,0x11,0x14,0x11,0x14,
0x10,0x04,0x10,0x04,0x10,0x14,0x10,0x14,0x10,0x04,
0x14,0x44,0x14,0x44,0x14,0x14,0x14,0x14,0x14,0x41,
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0x00,0x04,0x00,0x04,0x00,0x04,0x04,0x04,0x00,0x04,
};

PROGMEM static const uint8_t pokiwall[] = {
128,96,
//frame 0
0x77,0x77,0x77,0x77,0x77,0x77,0x77,0x77,0x77,0x77,0x77,0x77,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0x77,
0x79,0x88,0x88,0x88,0x88,0x87,0x88,0x87,0x98,0x88,0x88,0x88,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0x88,
0x79,0x88,0x88,0x88,0x88,0x78,0x88,0x87,0x98,0x88,0x88,0x88,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0x88,
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0x77,0x77,0x77,0x77,0x77,0x77,0x77,0x77,0x77,0x77,0x77,0x77,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0x77,
};

PROGMEM static const uint16_t palette[] = {
0x0, 0xffff, 0x4b44, 0x9f29, 0xf81f, 0xc1c7, 0xc307, 0x4a49, 0x6b4d, 0x7bcf, 0xc5f1, 0x948d, 0x5ae8,
};

PROGMEM static const uint8_t walltile[] = {
16,14,
//frame 0
0x77,0x77,0x77,0x77,0x77,0x77,0x77,0x77,
0x79,0x88,0x88,0x88,0x88,0x88,0x88,0x88,
0x79,0x88,0x88,0x88,0x88,0x88,0x88,0x88,
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0x77,0x77,0x77,0x77,0x77,0x77,0x77,0x77,
};

PROGMEM static const uint8_t gameover[4842] = {
110,88,
//frame 0
0x77,0x77,0x77,0x77,0x77,0x77,0x77,0x77,0x77,0x77,0x77,0x77,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0x77,
0x77,0x77,0x77,0x77,0x77,0x77,0x77,0x77,0x77,0x77,0x77,0x77,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0x77,
0x77,0x77,0x77,0x77,0x77,0x77,0x77,0x77,0x77,0x77,0x77,0x77,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0x77,
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0x99,0x99,0x99,0x99,0x99,0x99,0x99,0x99,0x99,0x99,0x99,0x99,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0x99,
};

PROGMEM static const uint8_t tenpts[90] = {
22,8,
//frame 0
0x44,0x44,0x44,0x44,0x44,0x44,0x44,0x44,0x44,0x44,0x44,
0x44,0x44,0x43,0x43,0x33,0x43,0x33,0x44,0x34,0x43,0x33,
0x44,0x44,0x33,0x43,0x23,0x43,0x23,0x43,0x33,0x43,0x32,
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0x42,0x44,0x42,0x42,0x22,0x44,0x44,0x44,0x44,0x44,0x44,
};

PROGMEM static const uint8_t pokifat0[] = {
12,22,
//frame 0
0x44,0x44,0x44,0x44,0x44,0x44,
0x44,0x44,0x44,0x44,0x44,0x44,
0x44,0x00,0x00,0x00,0x00,0x04,
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0x44,0x44,0x66,0x55,0x44,0x44,
};
PROGMEM static const uint8_t pokifat1[] = {
12,22,
//frame 6
0x44,0x00,0x00,0x00,0x00,0x04,
0x40,0x00,0x00,0x00,0x00,0x00,
0x00,0x00,0x00,0x00,0x01,0x00,
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0x44,0x44,0x44,0x44,0x44,0x44,
};
PROGMEM static const uint8_t pokifat2[] = {
12,22,
//frame 6
0x44,0x44,0x44,0x44,0x44,0x44,
0x44,0x44,0x44,0x44,0x44,0x44,
0x44,0x44,0x44,0x44,0x44,0x44,
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0x44,0x44,0x44,0x44,0x55,0x54,
};
PROGMEM static const uint8_t pokifat3[] = {
12,22,
//frame 6
0x44,0x44,0x44,0x44,0x44,0x44,
0x44,0x44,0x44,0x44,0x44,0x44,
0x44,0x00,0x00,0x00,0x00,0x04,
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0x44,0x44,0x66,0x55,0x44,0x44,
};
PROGMEM static const uint8_t pokifat4[] = {
12,22,
//frame 6
0x44,0x00,0x00,0x00,0x00,0x04,
0x40,0x00,0x00,0x00,0x00,0x00,
0x00,0x00,0x00,0x00,0x01,0x00,
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0x44,0x44,0x44,0x44,0x44,0x44,
};
PROGMEM static const uint8_t pokifat5[] = {
12,22,
//frame 6
0x44,0x44,0x44,0x44,0x44,0x44,
0x44,0x44,0x44,0x44,0x44,0x44,
0x44,0x44,0x44,0x44,0x44,0x44,
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0x44,0x44,0x44,0x46,0x64,0x44,
};

#define INV_DURATION 1000               //for how long the player cant take damage after taking damage in ms
#define SPAWN_TIMER 5000                //how much time it takes an enemy to spawn
#define KICK_FORCE 3.5
#define MAX_BALLSPD 15
#define MAX_WALKSPD 5
#define JUMP_TIME 220
#define SHAKE_DURATION 50
#define EYES_TIMER 2000
#define FAT_HEALTH 200

uint8_t screen = 2;                     //controls the different screens 0 = game, 1 = game over

float currentPlayerX = 0;               //current x coordinate of the player
float currentPlayerY = 0;               //current y coordinate of the player
float nextPlayerX = currentPlayerX;     //the next calculated x coordinate of the player
float nextPlayerY = currentPlayerY;     //the next calculated y coordiante of the player
float hSpd = 0;                         //the horizontal speed of the player (positive right negative left)
float vSpd = 0;                         //the vertical speed of the player (+ up, - down)
float gravity = 1.5;                    //how strong the player is affected by gravity
float friction = 0.7;                   //how much the player is affected by friction
float acceleration = 0.5;               //how fast the player can accelerate when walking
int jumpSpd = 8;                        //how quick and high the player can jump
bool lastDirRight = true;               //what direction the player is looking
int health = 4;                         //how much health the player has
unsigned int damageTimer = 1000;        //starts at 1000 to be vulnerable from the start
unsigned int jumpTimer = 0;
bool letGo = false;                     //makes sure the ball accelerates only once per kick

float ballCurrentX = 50;
float ballCurrentY = 65;
float ballNextX = ballCurrentX;
float ballNextY = ballCurrentY;
int ballDir = 0;
float ballSpd = 0;
float ballFriction = 0.08;
bool touchedBall = false;
float ballGravity = 1;

//these store the balls last 3 x and y values to draw the ghost behind the ball
int lastBallX1 = 0;
int lastBallY1 = 0;
int lastBallX2 = 0;
int lastBallY2 = 0;
int lastBallX3 = 0;
int lastBallY3 = 0;

int enemyX[10];
bool enemyState [10];
bool enemyLastRight [10];
int enemyY[10];
unsigned int spawnCounter = 0;
int enemyHealth[10];
bool enemyBallTouched[10];
int fatX = 50;
int fatY = 90;
bool fatState = false;
int fatHealth = FAT_HEALTH;
bool fatBallTouched = false;

int corpseX = 0;
int corpseY = 0;
bool corpseState = false;
int corpseDir = 0;
float corpseSpd = 0;

unsigned int freezeTimer = 0;
unsigned int shakeTimer = 0;
int bgXOffset = 0;
int bgYOffset = 0;
unsigned int score = 0;
int tptsX = 0;
int tptsY = 0;
int heartX = 0;
int heartY = 0;
unsigned int tptsCounter = 0;
unsigned int heartCounter = 0;
unsigned int eyesCounter = 0;
bool running = true;
bool pausePressed = false;

void drawTpts(){
    if (pok.getTime() - tptsCounter < 1000) {
        pok.display.drawBitmap(tptsX, tptsY, tenpts);
        tptsY -= 1;
    }
}

void drawHeart(){
    if (pok.getTime() - heartCounter < 1000) {
        pok.display.drawBitmap(heartX, heartY, pokiheart);
        heartY -= 1;
    }
}

void drawScore() {
    pok.display.drawBitmap(0, 10, scores);
    pok.display.setColor(1);
    pok.display.setCursor(21, 10);
    pok.display.print(score);
}

void killCorpse() {
    if (corpseX > 120 or corpseX < -10 or corpseY < -10 or corpseY > 98) {
        corpseState = false;
    }
    return;
}

void drawCorpse() {
    if (corpseState) {
        pok.display.drawBitmap(corpseX, corpseY, pokinemycrawl);
        pok.display.drawBitmapXFlipped(corpseX+4, corpseY, pokinemycrawl);
    }
    return;
}

void killPlayer() {
    if (health <= 0) {
        screen = 1;
        eyesCounter = pok.getTime();
    }
    return;
}

void enemyPlayerCollide() {
    if (pok.getTime() - damageTimer > INV_DURATION) {
        if (fatState && fatY == 66) {
            if (pok.collidePointRect(fatX + 6, fatY + 7, currentPlayerX + 3, currentPlayerY + 3, 10, 13)) {
                health -= 1;
                damageTimer = pok.getTime();
                return;
            }
        }
        for (int i = 0; i < 10; i++) {
            if (enemyState[i] && enemyY[i] == 72) {
                if (pok.collidePointRect(enemyX[i] + 4, 72, currentPlayerX + 3, currentPlayerY + 3, 10, 13)) {
                    health -= 1;
                    damageTimer = pok.getTime();
                    return;
                }
            }
        }
    }
    return;
}

void drawLife() {
    for (int i = 0; i < health; i++) {
        pok.display.drawBitmap(8*i, 0, pokiheart);
    }
    return;
}

void spawnEnemy() {
    long i = SPAWN_TIMER - score * 10;
    if (pok.getTime() - spawnCounter > max(abs(i), 500)) {
        spawnCounter = pok.getTime();
        //sapwn fat
        if (random(0, 5) == 0 && !fatState) {
            fatState = true;
            fatX = random(0, 100);
            fatHealth = FAT_HEALTH;
        }
        //spawn normal
        for (int i = 0; i < 10; i++) {
            if (!enemyState[i]) {
                enemyState[i] = true;
                enemyHealth[i] = 10;
                enemyX[i] = random(0, 102);
                enemyY[i] = 89;
                return;
            }
        }
    }
    //If code is here no more enemies could spawn
    return;
}

void riseEnemy() {
    for (int i = 0; i < 10; i++) {
        if (enemyState[i] && enemyY[i] > 72 && pok.frameCount % 2 == 0) {
            enemyY[i] -= 1;
        }
    }
    if (fatY > 66 && fatState) {
        fatY -= 1;
    }
    if (!fatState && fatY < 90) {
        fatY += 2;
    }
    return;
}

void initEnemyVars() {
    for (int i = 0; i < 10; i++) {
        enemyState[i] = false;
        enemyLastRight[i] = true;
        enemyHealth[i] = 10;
        enemyBallTouched[i] = false;
        enemyX[i] = random(0, 102);
        enemyY[i] = 89;
    }
    return;
}

void drawEnemy() {
    for (int i = 0; i < 10; i++) {                                                      //cycle thorugh all enemies
        if (enemyState[i]) {                                                            //only draw the enemy if it is alive
            if (!(enemyY[i] > 72)) {                                                    //draw his walking animation when hit is on the ground
                if (enemyLastRight[i]) {                                                //draw the right facing sprites if he last moved to the right
                    if (pok.frameCount % 40 < 10) {
                        pok.display.drawBitmap(enemyX[i], enemyY[i], pokinemy0);
                    } else if (pok.frameCount % 40 < 20) {
                        pok.display.drawBitmap(enemyX[i], enemyY[i], pokinemy1);
                    } else if (pok.frameCount % 40 < 30) {
                        pok.display.drawBitmap(enemyX[i], enemyY[i], pokinemy2);
                    } else {
                        pok.display.drawBitmap(enemyX[i], enemyY[i], pokinemy3);
                    }
                } else {                                                                //draw the left facing sprites if he last moved left
                    if (pok.frameCount % 40 < 10) {
                        pok.display.drawBitmapXFlipped(enemyX[i], enemyY[i], pokinemy0);
                    } else if (pok.frameCount % 40 < 20) {
                        pok.display.drawBitmapXFlipped(enemyX[i], enemyY[i], pokinemy1);
                    } else if (pok.frameCount % 40 < 30) {
                        pok.display.drawBitmapXFlipped(enemyX[i], enemyY[i], pokinemy2);
                    } else {
                        pok.display.drawBitmapXFlipped(enemyX[i], enemyY[i], pokinemy3);
                    }
                }
            } else {
                pok.display.drawBitmap(enemyX[i], enemyY[i], pokinemycrawl);            //draw a different sprite if he is still spawning
                pok.display.drawBitmapXFlipped(enemyX[i]+4, enemyY[i], pokinemycrawl);
            }
        }
    }
    if (fatY == 66) {
        if (currentPlayerX > fatX) {
            if (pok.frameCount % 30 < 5) {
                pok.display.drawBitmap(fatX, fatY, pokifat0);
            } else if (pok.frameCount % 30 < 10) {
                pok.display.drawBitmap(fatX, fatY, pokifat1);
            } else if (pok.frameCount % 30 < 15) {
                pok.display.drawBitmap(fatX, fatY, pokifat2);
            } else if (pok.frameCount % 30 < 20) {
                pok.display.drawBitmap(fatX, fatY, pokifat3);
            } else if (pok.frameCount % 30 < 25) {
                pok.display.drawBitmap(fatX, fatY, pokifat4);
            } else {
                pok.display.drawBitmap(fatX, fatY, pokifat5);
            }
        } else {
            if (pok.frameCount % 30 < 5) {
                pok.display.drawBitmapXFlipped(fatX, fatY, pokifat0);
            } else if (pok.frameCount % 30 < 10) {
                pok.display.drawBitmapXFlipped(fatX, fatY, pokifat1);
            } else if (pok.frameCount % 30 < 15) {
                pok.display.drawBitmapXFlipped(fatX, fatY, pokifat2);
            } else if (pok.frameCount % 30 < 20) {
                pok.display.drawBitmapXFlipped(fatX, fatY, pokifat3);
            } else if (pok.frameCount % 30 < 25) {
                pok.display.drawBitmapXFlipped(fatX, fatY, pokifat4);
            } else {
                pok.display.drawBitmapXFlipped(fatX, fatY, pokifat5);
            }
        }
    } else {
        pok.display.drawBitmap(fatX, fatY, pokifat0);
    }
    return;
}

//moves every enemy that is alive and on the ground 1 pixel closer to the player every frame
void moveEnemy() {
    for (int i = 0; i < 10; i++) {
        if (enemyState[i] && enemyY[i] == 72) {
            if (enemyX[i] > currentPlayerX) {
                enemyX[i] -= 1;
                enemyLastRight[i] = false;
            } else {
                enemyX[i] += 1;
                enemyLastRight[i] = true;
            }
        }
    }
    if (fatY == 66 && fatState) {
        if (currentPlayerX > fatX) {
            fatX += 1;
        } else {
            fatX -= 1;
        }
    }
    return;
}

float lenDirX(float len, int dir) {
    float pi = 3.14159265359;
    dir = ((-dir % 360)+ 360)% 360;
    float fDir = dir;
    return len * cos(pi * fDir / 180);
}

float lenDirY(float len, int dir) {
    float pi = 3.14159265359;
    dir = ((-dir % 360)+ 360)% 360;
    float fDir = dir;
    return len * sin(pi * fDir / 180);
}

int getAngle(long x1, long y1, long x2, long y2) {
    float i = y1 - y2;
    float j = x1 - x2;
    float pi = 3.14159265359;
    int angle = (atan2(i, j))*180 / pi;
    angle = (((-angle) % 360)+ 360)% 360;
    return angle;
}

void collidePlayerBall() {
    if (pok.collideRectRect(ballCurrentX -4, ballCurrentY -4, 9, 9, currentPlayerX + 2, currentPlayerY, 12, 22)) {
        if (!touchedBall) {
            touchedBall = true;
            ballDir = getAngle(ballCurrentX, ballCurrentY, currentPlayerX + 8, currentPlayerY + 12);
            ballSpd += KICK_FORCE;
            if (ballSpd > MAX_BALLSPD) {
                ballSpd = MAX_BALLSPD;
            }
        }
    } else {
        touchedBall = false;
    }
    return;
}

void frictionBall() {
    ballSpd -= ballFriction;
    if (ballSpd < 0) {
        ballSpd = 0;
    }
    return;
}

void bounceBall() {
    if (ballNextX >= 106 or ballNextX <= 4) {
        ballDir = (((180 - ballDir)% 360)+ 360)% 360;
    }
    if (ballNextY >= 83 or ballNextY <= 4) {
        ballDir = (((360 - ballDir)% 360)+ 360)% 360;
    }
    return;
}

void containBall() {
    if (ballNextX > 106) {
        ballNextX = 106;
    } else if (ballNextX < 4){
        ballNextX = 4;
    }
    if (ballNextY > 83) {
        ballNextY = 83;
    } else if (ballNextY < 4) {
        ballNextY = 4;
    }
    return;
}

void moveBall() {
    //lastball is unly used to draw the ballGhost
    lastBallX3 = lastBallX2;
    lastBallX2 = lastBallX1;
    lastBallX1 = ballCurrentX;

    lastBallY3 = lastBallY2;
    lastBallY2 = lastBallY1;
    lastBallY1 = ballCurrentY;


    ballCurrentX = ballNextX;
    ballCurrentY = ballNextY;

    ballNextX = ballCurrentX + lenDirX(ballSpd, ballDir);
    ballNextY = ballCurrentY + ballGravity + lenDirY(ballSpd, ballDir);
    return;
}

void setSpd() {
    if (pok.buttons.rightBtn() && hSpd < MAX_WALKSPD) {
        hSpd += acceleration + friction;
        lastDirRight = true;
    }
    if (pok.buttons.leftBtn() && hSpd > -MAX_WALKSPD) {
        hSpd -= acceleration + friction;
        lastDirRight = false;
    }
    if (currentPlayerY >= 64) {
        jumpTimer = pok.getTime();
        letGo = false;
    } else {
        if (!pok.buttons.aBtn()) {
            letGo = true;
        }
    }
    if (pok.buttons.aBtn() && pok.getTime() - jumpTimer < JUMP_TIME && !letGo) {
        vSpd = -jumpSpd;
    }
    return;
}

void frictionGravity() {
    vSpd += gravity;

    if (hSpd > 0) {
        if (hSpd - friction > 0) {
            hSpd -= friction;
        } else {
            hSpd = 0;
        }
    } else if (hSpd < 0) {
        if (hSpd + friction < 0) {
            hSpd += friction;
        } else {
            hSpd = 0;
        }
    }

    if (vSpd > 0) {
        if (vSpd - friction > 0) {
            vSpd -= friction;
        } else {
            vSpd = 0;
        }
    } else if (vSpd < 0) {
        if (vSpd + friction < 0) {
            vSpd += friction;
        } else {
            vSpd = 0;
        }
    }
    return;
}

void movePlayer() {
    currentPlayerX = nextPlayerX;
    currentPlayerY = nextPlayerY;

    nextPlayerX = currentPlayerX + hSpd;
    nextPlayerY = currentPlayerY + vSpd;
    return;
}

void drawPlayer() {
    if (lastDirRight) {
        if (pok.buttons.rightBtn() and currentPlayerY >= 65) {      //if player walking right
            if (pok.frameCount % 16 < 2) {
                pok.display.drawBitmap(currentPlayerX, currentPlayerY, pokiboi0);
            } else if (pok.frameCount % 16 < 4) {
                pok.display.drawBitmap(currentPlayerX, currentPlayerY, pokiboi1);
            } else if (pok.frameCount % 16 < 6) {
                pok.display.drawBitmap(currentPlayerX, currentPlayerY, pokiboi2);
            } else if (pok.frameCount % 16 < 8) {
                pok.display.drawBitmap(currentPlayerX, currentPlayerY, pokiboi3);
            } else if (pok.frameCount % 16 < 10) {
                pok.display.drawBitmap(currentPlayerX, currentPlayerY, pokiboi0);
            } else if (pok.frameCount % 16 < 12) {
                pok.display.drawBitmap(currentPlayerX, currentPlayerY, pokiboi5);
            } else if (pok.frameCount % 16 < 14) {
                pok.display.drawBitmap(currentPlayerX, currentPlayerY, pokiboi6);
            } else if (pok.frameCount % 16 < 16) {
                pok.display.drawBitmap(currentPlayerX, currentPlayerY, pokiboi7);
            }
        } else if (currentPlayerY < 65) {
            pok.display.drawBitmap(currentPlayerX, currentPlayerY, pokiboi2);
        } else {
            pok.display.drawBitmap(currentPlayerX, currentPlayerY, pokiboi0);
        }
    } else {
        if (pok.buttons.leftBtn() and currentPlayerY >= 65) { //if player walking left
            if (pok.frameCount % 16 < 2) {
                pok.display.drawBitmapXFlipped(currentPlayerX, currentPlayerY, pokiboi0);
            } else if (pok.frameCount % 16 < 4) {
                pok.display.drawBitmapXFlipped(currentPlayerX, currentPlayerY, pokiboi1);
            } else if (pok.frameCount % 16 < 6) {
                pok.display.drawBitmapXFlipped(currentPlayerX, currentPlayerY, pokiboi2);
            } else if (pok.frameCount % 16 < 8) {
                pok.display.drawBitmapXFlipped(currentPlayerX, currentPlayerY, pokiboi3);
            } else if (pok.frameCount % 16 < 10) {
                pok.display.drawBitmapXFlipped(currentPlayerX, currentPlayerY, pokiboi0);
            } else if (pok.frameCount % 16 < 12) {
                pok.display.drawBitmapXFlipped(currentPlayerX, currentPlayerY, pokiboi5);
            } else if (pok.frameCount % 16 < 14) {
                pok.display.drawBitmapXFlipped(currentPlayerX, currentPlayerY, pokiboi6);
            } else if (pok.frameCount % 16 < 16) {
                pok.display.drawBitmapXFlipped(currentPlayerX, currentPlayerY, pokiboi7);
            }
        } else if (currentPlayerY < 65) {   //if player jumping
            pok.display.drawBitmapXFlipped(currentPlayerX, currentPlayerY, pokiboi2);
        } else {                            //if player standing still
            pok.display.drawBitmapXFlipped(currentPlayerX, currentPlayerY, pokiboi0);
        }
    }
    return;
}

void containPlayer() {
    if (nextPlayerX > 94) {
        nextPlayerX = 94;
    } else if (nextPlayerX < 0){
        nextPlayerX = 0;
    }
    if (nextPlayerY > 65) {
        nextPlayerY = 65;
    } else if (nextPlayerY < 0) {
        nextPlayerY = 0;
    }
    return;
}

void drawBall() {
    if (ballSpd < 10) {
        pok.display.drawBitmap(ballCurrentX -4, ballCurrentY -4, pokiball); //draw slow ball
        pok.display.drawBitmapXFlipped(ballCurrentX -1, ballCurrentY -4, pokiball);
    } else {
        pok.display.drawBitmap(ballCurrentX -4, ballCurrentY -4, pokiballfast);   //draw red ball and its ghosts
        pok.display.drawBitmapXFlipped(ballCurrentX -1, ballCurrentY -4, pokiballfast);

        pok.display.drawBitmap(lastBallX1 -3, lastBallY1 -3, pokiballlast1);
        pok.display.drawBitmapXFlipped(lastBallX1, lastBallY1 -3, pokiballlast1);

        pok.display.drawBitmap(lastBallX2 -2, lastBallY2 -2, pokiballlast2);
        pok.display.drawBitmapXFlipped(lastBallX2 -1, lastBallY2 -2, pokiballlast2);

        pok.display.drawBitmap(lastBallX3 -1, lastBallY3 -1, pokiballlast3);
        pok.display.drawBitmapXFlipped(lastBallX3, lastBallY3 -1, pokiballlast3);
    }
    return;
}

void drawBackground() {
    //for (int x = 0; x < 8; x++){
    //    for (int y = 0; y < 8; y++){
    //        pok.display.drawBitmap((x * 16)-3 + bgXOffset, (y * 14)-3 + bgYOffset, walltile);
    //    }
    //}
    pok.display.drawBitmap(-7 + bgXOffset, -6 + bgYOffset, pokiwall);
    return;
}

void drawArrow() {
    pok.display.setColor(5);
    int angle = getAngle(ballCurrentX, ballCurrentY, currentPlayerX + 8, currentPlayerY + 12);
    pok.display.drawLine(ballCurrentX, ballCurrentY, ballCurrentX + lenDirX(10, angle), ballCurrentY + lenDirY(10, angle));
    return;
}

void ballEnemyCollide() {
    if (ballSpd >= 4) {     //only damage if ball faster than 4
        for (int i = 0; i < 10; i++) {
            if (enemyState[i]) {
                if (pok.collideRectRect(ballCurrentX - 4, ballCurrentY - 4, 9, 9, enemyX[i], enemyY[i], 8, 16)) {
                    if (!enemyBallTouched[i]) {
                            enemyBallTouched[i] = true;
                        enemyHealth[i] -= ballSpd;
                    }
                } else {
                    enemyBallTouched[i] = false;
                }
            }
        }
        if (fatState) {
            if (pok.collideRectRect(ballCurrentX - 4, ballCurrentY - 4, 9, 9, fatX, fatY, 12, 22)) {
                if (!fatBallTouched) {
                    fatBallTouched = true;
                    fatHealth -= ballSpd;
                }
            } else {
                fatBallTouched = false;
            }
        }
    }
    return;
}

void killEnemy() {
    for (int i = 0; i < 10; i++) {
        if (enemyState[i]) {
            if (enemyHealth[i] <= 0) {
                freezeTimer = pok.getTime();
                enemyState[i] = false;

                corpseState = true;         //spawn corpse
                corpseX = enemyX[i];
                corpseY = enemyY[i];
                corpseDir = ballDir;
                corpseSpd = ballSpd/1.5;

                score += 10;
                tptsX = enemyX[i];
                tptsY = enemyY[i];
                tptsCounter = pok.getTime();
            }
        }
    }
    if (fatState) {
        if (fatHealth <= 0) {
            freezeTimer = pok.getTime();
            fatState = false;
            if (health < 5) {
                health += 1;
                heartCounter = pok.getTime();
                heartX = fatX;
                heartY = fatY;
            }
        }
    }
    return;
}

void shakeScreen() {
    //if ball is moving fast and hitting a wall
    if ((ballSpd >= 10) && (ballCurrentX == 4 or ballCurrentX == 106 or ballCurrentY == 4 or ballCurrentY == 83)) {
        shakeTimer = pok.getTime();
    }

    if (pok.getTime() - shakeTimer < SHAKE_DURATION) {
        bgXOffset = random(-2, 3);
        bgYOffset = random(-2, 3);
    } else {
        bgXOffset = 0;
        bgYOffset = 0;
    }
    return;
}

void moveCorpse() {
    if (corpseState) {
        corpseX = corpseX + lenDirX(corpseSpd, corpseDir);
        corpseY = corpseY + lenDirY(corpseSpd, corpseDir);
    }
    return;
}

void drawEyes() {
    pok.display.setColor(7);
    pok.display.drawPixel(46, 71);
    pok.display.drawPixel(46, 75);
    return;
}

void drawScore2() {
    pok.display.setColor(1);
    pok.display.setCursor(4, 79);
    pok.display.print(score);
    return;
}

void resetGame() {
    screen = 0;
    fatState = false;
    ballSpd = 0;
    score = 0;
    health = 5;
    for (int i = 0; i < 10; i++) {
        enemyState[i] = false;
    }
}

void pauseGame() {
    if (running && pok.buttons.bBtn() && !pausePressed) {
        running = false;
        pausePressed = true;
    } else if (!running && pok.buttons.bBtn() && !pausePressed) {
        running = true;
        pausePressed = true;
    }
    if (!pok.buttons.bBtn()) {
        pausePressed = false;
    }
}

void drawPause() {
    if (!running) {
        pok.display.setColor(0);
        pok.display.fillRect(30, 38, 56, 10);
        pok.display.setCursor(32, 40);
        pok.display.setColor(1);
        pok.display.print("PAUSED");
    }
}


void setup(){
    pok.begin();
    pok.display.load565Palette(palette);
    pok.display.bgcolor = 4;
    pok.display.setInvisibleColor(4);
    pok.setFrameRate(30);
    initEnemyVars();
    //pok.sound.ampEnable(1);
  }



void loop() {
        if( pok.update()) {
            PD::update();
            //pok.buttons.pollButtons();
            if (screen == 0) {
                pauseGame();
                if (pok.getTime() - freezeTimer > 200 && running) {
                    shakeScreen();
                    moveCorpse();
                    killCorpse();
                    enemyPlayerCollide();
                    killPlayer();
                    collidePlayerBall();
                    setSpd();
                    ballEnemyCollide();
                    frictionGravity();
                    frictionBall();
                    movePlayer();
                    moveEnemy();
                    moveBall();
                    containPlayer();
                    bounceBall();
                    containBall();
                    spawnEnemy();
                    riseEnemy();
                    killEnemy();
                }
                drawBackground();
                drawEnemy();
                drawCorpse();
                drawPlayer();
                drawArrow();
                drawBall();
                drawTpts();
                drawHeart();
                drawLife();
                drawScore();
                drawPause();
            } else if (screen == 1) {
                pok.display.drawBitmap(0, 0, gameover);
                if (pok.getTime() - eyesCounter > EYES_TIMER) {
                    drawEyes();
                }
                drawScore2();
                if (pok.buttons.bBtn()) {
                    resetGame();
                    pausePressed = true;
                }
            } else if (screen == 2) {
                if (pok.buttons.bBtn()) {
                    pausePressed = true;
                    screen = 0;
                }
                pok.display.drawBitmap(0, 0, start);
            }
        }
}
